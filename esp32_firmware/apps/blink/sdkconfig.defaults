## esp32_firmware/apps/blink/sdkconfig.defaults
```kconfig
# Defaults for classic ESP32 (WROOM) DevKit-style boards.
# Adjust flash size after esptool flash_id if needed.

CONFIG_IDF_TARGET="esp32"
CONFIG_ESPTOOLPY_FLASHSIZE_4MB=y
CONFIG_ESP_CONSOLE_UART_DEFAULT=y
CONFIG_ESP_CONSOLE_UART_BAUDRATE=115200
```

## esp32_firmware/apps/wifi_connect/sdkconfig.defaults
```kconfig
CONFIG_IDF_TARGET="esp32"
CONFIG_ESPTOOLPY_FLASHSIZE_4MB=y
CONFIG_ESP_CONSOLE_UART_DEFAULT=y
CONFIG_ESP_CONSOLE_UART_BAUDRATE=115200
# Prefer LAN NTP + public fallbacks (see main.c SNTP_SERVER_*)
CONFIG_LWIP_SNTP_MAX_SERVERS=3
```

## esp32_firmware/apps/wifi_scan/sdkconfig.defaults
```kconfig
CONFIG_IDF_TARGET="esp32"
CONFIG_ESPTOOLPY_FLASHSIZE_4MB=y
CONFIG_ESP_CONSOLE_UART_DEFAULT=y
CONFIG_ESP_CONSOLE_UART_BAUDRATE=115200

# STA mode scan only — no password / join required for listing APs
CONFIG_ESP_WIFI_STATIC_RX_BUFFER_NUM=10
CONFIG_ESP_WIFI_DYNAMIC_RX_BUFFER_NUM=32
```
